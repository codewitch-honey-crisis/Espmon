## espmon-esp32/boards/matouch-parallel-35/managed_components/codewitch-honey-crisis__htcw_ml/zephyr/Kconfig
```kconfig
menu "htcw_io configuration"
  config HTCW_ML
    bool "Enable HTCW_ML"
    default n
endmenu
```

## espmon-esp32/boards/matouch-parallel-35/sdkconfig.defaults
```kconfig
# ESP32-S3 target
CONFIG_IDF_TARGET="esp32s3"

# Flash settings
CONFIG_ESPTOOLPY_FLASHMODE_DIO=y
CONFIG_ESPTOOLPY_FLASHFREQ_80M=y
CONFIG_ESPTOOLPY_FLASHSIZE_4MB=y

# Partition table
CONFIG_PARTITION_TABLE_SINGLE_APP=y

# FreeRTOS
CONFIG_FREERTOS_HZ=1000

# Component config can go here if needed
```

## espmon-esp32/boards/matouch-parallel-4/managed_components/codewitch-honey-crisis__htcw_bits/zephyr/Kconfig
```kconfig
menu "htcw_bits configuration"
  config HTCW_BITS
    bool "Enable HTCW_BITS"
    default n
endmenu
```

## espmon-esp32/boards/matouch-parallel-4/managed_components/codewitch-honey-crisis__htcw_frame/zephyr/Kconfig
```kconfig
menu "htcw_frame configuration"
  config HTCW_FRAME
    bool "Enable HTCW_FRAME"
    default n
endmenu
```

## espmon-esp32/boards/matouch-parallel-43/managed_components/codewitch-honey-crisis__htcw_data/zephyr/Kconfig
```kconfig
menu "htcw_data configuration"
  config HTCW_DATA
    bool "Enable HTCW_DATA"
    default n
endmenu
```

## espmon-esp32/boards/matouch-parallel-43/managed_components/codewitch-honey-crisis__htcw_io/zephyr/Kconfig
```kconfig
menu "htcw_io configuration"
  config HTCW_IO
    bool "Enable HTCW_IO"
    depends on CPP
    select REQUIRES_FULL_LIBC
    default n
endmenu
```
